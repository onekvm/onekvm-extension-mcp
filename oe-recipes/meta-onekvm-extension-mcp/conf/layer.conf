## oe-recipes/meta-onekvm-extension-mcp/conf/layer.conf
```bitbake
BBPATH .= ":${LAYERDIR}"

BBFILES += "${LAYERDIR}/recipes-*/*/*.bb \
            ${LAYERDIR}/recipes-*/*/*.bbappend"

BBFILE_COLLECTIONS += "onekvm-extension-mcp"
BBFILE_PATTERN_onekvm-extension-mcp := "^${LAYERDIR}/"
BBFILE_PRIORITY_onekvm-extension-mcp = "8"

LAYERDEPENDS_onekvm-extension-mcp = "core onekvm"
LAYERSERIES_COMPAT_onekvm-extension-mcp = "wrynose"
```
